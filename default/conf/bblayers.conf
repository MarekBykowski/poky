## default/conf/bblayers.conf
```bitbake
# POKY_BBLAYERS_CONF_VERSION is increased each time build/conf/bblayers.conf
# changes incompatibly
POKY_BBLAYERS_CONF_VERSION = "2"

BBPATH = "${TOPDIR}"
BBFILES ?= ""

BBLAYERS ?= " \
  /home/marek/yocto/poky/meta \
  /home/marek/yocto/poky/meta-poky \
  /home/marek/yocto/poky/meta-yocto-bsp \
  "
```
